## imx-windows-iot/build/firmware/its/uefi_imx8m_unsigned.its
```
/dts-v1/;

/ {
	description = "UEFI Firmware";

	images {
		uefi {
			description = "UEFI";
			data = /incbin/("./IMXBOARD_EFI.fd.gz");
			type = "kernel";
			arch = "arm64";
			os = "linux";
			compression = "gzip";
			load = <0x50004000>;
			entry = <0x50004000>;
			hash-1 {
				algo = "sha256";
			};
		};
	};
	configurations {
		default = "conf-1";
		conf-1 {
			description = "UEFI Firmware";
			kernel = "uefi";
		};
	};
};
```

## imx-windows-iot/build/firmware/its/uefi_imx93_unsigned.its
```
/dts-v1/;

/ {
	description = "UEFI Firmware";

	images {
		uefi {
			description = "UEFI";
			data = /incbin/("./IMXBOARD_EFI.fd");
			type = "kernel";
			arch = "arm64";
			os = "linux";
			compression = "none";
			load = <0x82304000>;
			entry = <0x82304000>;
			hash-1 {
				algo = "sha256";
			};
		};
	};
	configurations {
		default = "conf-1";
		conf-1 {
			description = "UEFI Firmware";
			kernel = "uefi";
		};
	};
};
```
